## conf/distro/poky-customer.conf
```bitbake
# Copyright (C) 2016 Stephan Dünner <stephan.duenner@bytesatwork.ch>
# Released under the MIT license (see COPYING.MIT for the terms)

require conf/distro/poky-bytesatwork.conf

DISTRO = "poky-customer"
```

## conf/layer.conf
```bitbake
# Copyright (C) 2016 Stephan Dünner <stephan.duenner@bytesatwork.ch> 
# Released under the MIT license (see COPYING.MIT for the terms)

# We have a conf and classes directory, add to BBPATH
BBPATH =. "${LAYERDIR}:"

# We have recipes-* directories, add to BBFILES
BBFILES += "${LAYERDIR}/recipes-*/*/*.bb \
            ${LAYERDIR}/recipes-*/*/*.bbappend"

BBFILE_COLLECTIONS += "meta-customer"
BBFILE_PATTERN_meta-customer = "^${LAYERDIR}/"
BBFILE_PRIORITY_meta-customer = "8"

LAYERDEPENDS_meta-customer = " \
	meta-bytesatwork \
"
```

## conf/machine/customer-machine.conf
```bitbake
# Copyright (C) 2016 Stephan Dünner <stephan.duenner@bytesatwork.ch>
# Released under the MIT license (see COPYING.MIT for the terms)

#@TYPE: Machine
#@NAME: customer
#@DESCRIPTION: Customer

DEFAULTTUNE = "cortexa8hf-neon"
require conf/machine/include/tune-cortexa8.inc

IMAGE_FSTYPES += "sdimg.gz"
JFFS2_ERASEBLOCK = "0x20000"
EXTRA_IMAGECMD_jffs2 = "--eraseblock=${JFFS2_ERASEBLOCK} --no-cleanmarkers --little-endian"
JFFS2_SUM_EXTRA_ARGS = "--eraseblock=${JFFS2_ERASEBLOCK} --cleanmarker 16 --littleendian --pad"

SERIAL_CONSOLES = "115200;ttyO0"

UBOOT_MACHINE = "am335x_m2_config"
UBOOT_ENTRYPOINT = "0x80008000"
UBOOT_LOADADDRESS = "0x80008000"

KERNEL_IMAGETYPE = "uImage"
KERNEL_DEVICETREE = "bytepanel-et10.dts"
PREFERRED_PROVIDER_virtual/kernel = "linux-ti-staging"
PREFERRED_PROVIDER_virtual/bootloader = "u-boot-ti-staging"
PREFERRED_VERSION_u-boot-ti-staging = "2014.07+gitAUTOINC+fb6ab76dad"

PREFERRED_PROVIDER_jpeg = "jpeg"
PREFERRED_PROVIDER_jpeg-native = "jpeg-native"
PREFERRED_PROVIDER_make-native = "make-native"



MACHINE_FEATURES = "ext2 rtc serial touchscreen usbhost vfat"
```
